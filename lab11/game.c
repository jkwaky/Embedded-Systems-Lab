#include <string.h>
#include <stdint.h>
#include <stdlib.h>
#include "ST7735.h"
#include "button.h"
#include "PLL.h"
#include "ADCSWTrigger.h"
#include "../inc/tm4c123gh6pm.h"
#include "UART.h"

uint8_t Connected = 0; //tells whether we are connected to the internet or not
uint8_t host = 0;
int difficulty = 3;
extern int buttonStates;
char score[16] = "P1: ||P2: ";
char score1[16] = "Score: ";
char SSID[18] = "WTest";
char user[16] = "Joe            ";
char Password[18] = "PTestnetwork";
char winner1[16] = "Player1 wins!!!";
char winner2[16] = "Player2 wins!!!";
void EnableInterrupts(void);  // Enable interrupts
char empty[2];
typedef struct Player{
		int16_t now;
		int16_t prev;
}Player;

typedef struct position{
    uint16_t x;
    uint16_t y;
}position;

typedef struct balls{
	position now;
	position prev;
	int VelX;
	int VelY;
}balls;
const unsigned short Ponglogobmp[] = {
 0x0000, 0x0000, 0x0000, 0x0000, 0x0000, 0x0000, 0x0000, 0x0000, 0x0000, 0x0000, 0x0000, 0x0000, 0x0000, 0x0000, 0x0000, 0x0000,
 0x0000, 0x0000, 0x0000, 0x0000, 0x0000, 0x0000, 0x0000, 0x0000, 0x0000, 0x0000, 0x0000, 0x0000, 0x0000, 0x0000, 0x0000, 0x0000,
 0x0000, 0x0000, 0x0000, 0x0000, 0x0000, 0x0000, 0x0000, 0x0000, 0x0000, 0x0000, 0x0000, 0x0000, 0x0000, 0x0000, 0x0000, 0x0000,
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 0x0000, 0x0000, 0x0000, 0x0000, 0x0000, 0x0000, 0x0000, 0x0000,

};



/*
Global Variables

*/
int p1 = 0;
int p2 = 0;
extern char randomNumber[];
char playa[3] = {'X', 0, 0};
extern char other[3];
uint8_t host;
balls game_ball;
Player player1, player2;
int game_check =1;
int8_t rando = 0;
int game_ready = 0;
uint8_t refresh = 0;
/*
Draw the field: the middle line, goals, and goalies and ball.

*/

void Timer2_Init(unsigned long period){
  SYSCTL_RCGCTIMER_R |= 0x04;   // 0) activate timer2
  TIMER2_CTL_R = 0x00000000;    // 1) disable timer2A during setup
  TIMER2_CFG_R = 0x00000000;    // 2) configure for 32-bit mode
  TIMER2_TAMR_R = 0x00000002;   // 3) configure for periodic mode, default down-count settings
  TIMER2_TAILR_R = period-1;    // 4) reload value
  TIMER2_TAPR_R = 0;            // 5) bus clock resolution
  TIMER2_ICR_R = 0x00000001;    // 6) clear timer2A timeout flag
  TIMER2_IMR_R = 0x00000001;    // 7) arm timeout interrupt
  NVIC_PRI5_R = (NVIC_PRI5_R&0x00FFFFFF)|0x80000000; // 8) priority 4
// interrupts enabled in the main program after all devices initialized
// vector number 39, interrupt number 23
  NVIC_EN0_R = 1<<23;           // 9) enable IRQ 23 in NVIC
  TIMER2_CTL_R = 0x00000001;    // 10) enable timer2A
	
}

void Timer2A_Handler(void){
  TIMER2_ICR_R = TIMER_ICR_TATOCINT;// acknowledge TIMER2A timeout
	refresh = 1;
}


void Timer2Init(){
	volatile uint32_t delay;
  SYSCTL_RCGCGPIO_R |= 0x20;       // activate port F
  delay = SYSCTL_RCGCGPIO_R;       // allow time to finish activating
  GPIO_PORTF_DIR_R |= 0x0E;        // make PF3-1 output (PF3-1 built-in LEDs)
  GPIO_PORTF_AFSEL_R &= ~0x0E;     // disable alt funct on PF3-1
  GPIO_PORTF_DEN_R |= 0x0E;        // enable digital I/O on PF3-1
                                   // configure PF3-1 as GPIO
  GPIO_PORTF_PCTL_R = (GPIO_PORTF_PCTL_R&0xFFFF000F)+0x00000000;
  GPIO_PORTF_AMSEL_R = 0;          // disable analog functionality on PF
//  Timer2_Init(&UserTask, 4000);    // initialize timer2 (20,000 Hz)
  Timer2_Init(1000000); // initialize timer2 (16 Hz)
//  Timer2_Init(&UserTask, 80000000);// initialize timer2 (1 Hz)
//  Timer2_Init(&UserTask, 0xFFFFFFFF); // initialize timer2 (slowest rate)
}
uint16_t getOtherPlayer1(){
	uint8_t x;
	if(host) x= (uint16_t)(uint8_t) player1.now;
	else x = (uint16_t)(uint8_t) player2.now;
	return x;
}

uint16_t getOtherPlayer(){
	return other[1];
}
int8_t getRand(){
	return (int8_t)randomNumber[1];
}
void editR(){
	randomNumber[1] = rando;
	
}
void editScore1(){
		int m = 0;
    m = p1;
    int one = 0;
    int ten = 0;
    int hundred =  0;
    one = m % 10;
    m = m/10;
    ten = m % 10;
    m = m/10;
    hundred = m % 10;
		if(m > 999){
			score1[6] = '9';
			score1[7] = '9';
			score1[8] = '9';
		}
		else{
    score1[6] = (hundred + 48);
		score1[7] = (ten + 48); 
		score1[8] = one +48;
		}
}
void editScore(){
		score[3] = p1 + 48;
		score[9] = p2 +48;
}
void editX(){
	if(host) playa[1] = player1.now;
	else playa[1] = player2.now;
}
void createRand(){
	int x = (rand()%19);
	x = x%2;
	
	rando = (rand()&difficulty);//used to be 3
	if(x){
		rando = rando*-1;
	}
	editR();
}

uint16_t ConvertADC(uint32_t ADCVal){
		if(ADCVal > 2048) return 100;
    return (90*(ADCVal))/2048;

}
void erase_ball(int width, uint16_t color){
	for(uint16_t i=0; i < width; i++){
		for(uint16_t j = 0; j< width; j++){
			ST7735_DrawPixel(game_ball.prev.x + i, game_ball.prev.y + j, color);
		}
	}
}
void draw_ball(int width, uint16_t color){
	for(uint16_t i=0; i < width; i++){
		for(uint16_t j = 0; j< width; j++){
			ST7735_DrawPixel(game_ball.now.x + i, game_ball.now.y + j, color);
		}
	}
}

void update_Screen(){
		erase_ball(8, ST7735_BLACK);
		game_ball.prev = game_ball.now;
		draw_ball(8, ST7735_RED);
		uint32_t ADCVal = ADC0_InSeq3();
    if(host){
			player1.now = ConvertADC(ADCVal);
			if(player1.now != player1.prev) {
				editX();
				UART_OutString(playa);
			}
			player2.now = getOtherPlayer();
		}
		else{
			player2.now = ConvertADC(ADCVal);
			if(player2.now != player2.prev) {
				editX();
				UART_OutString(playa);
			}
			player1.now = getOtherPlayer();
		}
		//if(player1.prev != player1.now){
			ST7735_DrawFastHLine(0, 159, 130, ST7735_BLACK);
			ST7735_DrawFastHLine(player1.now, 159, 30, ST7735_YELLOW);
			player1.prev= player1.now;
		//}
		//if(player2.prev != player2.now){
			ST7735_DrawFastHLine(0, 0, 130, ST7735_BLACK);
			ST7735_DrawFastHLine(player2.now, 0, 30, ST7735_YELLOW);
			player2.prev= player2.now;
		//}
		
		


    //ST7735_DrawFastHLine(0, 20, 5, ST7735_YELLOW);
}




void drawField(){
		//ST7735_FillScreen(ST7735_BLACK);
    ST7735_DrawFastHLine(0, 79, 127, ST7735_WHITE); //middle line
    ST7735_DrawFastVLine(0,0, 160, ST7735_WHITE);	//side lines
    ST7735_DrawFastVLine(127,0, 160, ST7735_WHITE);
		uint32_t ADCVal = ADC0_InSeq3();//update player1 position
		//if(host){
			//player1.now = ConvertADC(ADCVal);//converts ADC to a value between 0-15 (the x position of the screen)
			//player2.now = getOtherPlayer();
		//}
		//else{
			//player2.now = ConvertADC(ADCVal);
			//player1.now = getOtherPlayer();
		//}
		
			
}
void game_init(){
		ST7735_FillScreen(ST7735_BLACK);

		drawField();
		game_ball.prev.x= 63;
		game_ball.now.x = 63;
		game_ball.prev.y= 79;
		game_ball.now.y = 79;
		game_ball.VelY =1;
		game_ball.VelX = 0;
	
	  update_Screen();


}

/*
Updates the player and ball positions
player.now is the potentiometer position on the screen

sends player position through UART
receives opponent position through UART

sends/receives randum number through UART
*/
void playgame1(){
		if(game_ball.now.x == 1 || game_ball.now.x > 112){
			game_ball.VelX = game_ball.VelX*-1;
		}
		if(game_ball.now.y == 79){
			if(host == 1){
				createRand();
				//UART_OutString(randomNumber);
			}
			else{
				rando = getRand();
			}
		}
		if(game_ball.VelY > 0){
			if(game_ball.now.y <154){
				game_ball.now.y += game_ball.VelY;
				game_ball.now.x += game_ball.VelX;
			}
			else{
				if((player1.now < game_ball.now.x) &&(player1.now + 30 > game_ball.now.x)){
					
					game_ball.VelY = game_ball.VelY*-1;
					game_ball.VelX = rando;
					p1 ++;
				}
				else{
					game_check = 0;
				}
			}
		}
		else{
			if(game_ball.now.y > 1){
				game_ball.now.y += game_ball.VelY;
				game_ball.now.x += game_ball.VelX;
			}
			else{
				if((player2.now < game_ball.now.x) && (player2.now + 30 > game_ball.now.x)){
					game_ball.VelY = game_ball.VelY*-1;
					game_ball.VelX = rando;
					p1 ++;
				}
				else{
					game_check = 0;
				}
			}
		}
    //Player_2 = getPlayer2(Player_2);
    update_Screen();
		drawField();
}
void playgame(){
	
		if(game_ball.now.x == 1 || game_ball.now.x > 112){
			game_ball.VelX = game_ball.VelX*-1;
		}
		if(game_ball.now.y == 79){
			if(host == 1){
				createRand();
				UART_OutString(randomNumber);
				UART_OutString(randomNumber);
				UART_OutString(randomNumber);
			}
		}
		if(game_ball.VelY > 0){
			if(game_ball.now.y <154){
				game_ball.now.y += game_ball.VelY;
				game_ball.now.x += game_ball.VelX;
			}
			else{
				if((player1.now < game_ball.now.x) &&(player1.now + 30 > game_ball.now.x)){
					
					game_ball.VelY = game_ball.VelY*-1;
					game_ball.VelX = rando;
				}
				else{
					p2 ++;
					game_check = 0;
				}
			}
		}
		else{
			if(game_ball.now.y > 1){
				game_ball.now.y += game_ball.VelY;
				game_ball.now.x += game_ball.VelX;
				
			}
			else{
				if((player2.now < game_ball.now.x) && (player2.now + 30 > game_ball.now.x)){
					game_ball.VelY = game_ball.VelY*-1;
					game_ball.VelX = rando;
				}
				else{
					p1 ++;
					game_check = 0;
				}
			}
		}
    //Player_2 = getPlayer2(Player_2);
    update_Screen();
		drawField();
}

void setWifiNetwork(char *network){
	while(1){
	int8_t letterHolder = 0;
	uint8_t characterIndex = 0;
	uint8_t button = 0;
	ST7735_FillScreen(ST7735_BLACK);
	for(int i = 0; i<16; i++){
	ST7735_DrawChar(10+(7*i), 60, network[i], ST7735_WHITE, ST7735_BLACK, 1);
	}
	ST7735_FillRect(9, 68, 7, 3, ST7735_WHITE);
	while(1){
	while(!button){
		button = buttonStates;
	}
	buttonStates = 0;
	if(button&0x1){
		if(characterIndex == 0x7F){
			network[letterHolder] = 0;
			return;
		}
		ST7735_FillRect(10+(7*letterHolder)-1, 68, 7, 3, ST7735_BLACK);
		letterHolder -=1;
		letterHolder &= 0xF;
		ST7735_FillRect(10+(7*letterHolder)-1, 68, 7, 3, ST7735_WHITE);
	}
	else{
		if(button&0x2){
		if(characterIndex == 0x7F){
			network[letterHolder] = 0;
			return;
		}
		ST7735_FillRect(10+(7*letterHolder)-1, 68, 7, 3, ST7735_BLACK);
		letterHolder +=1;
		letterHolder &= 0xF;
		ST7735_FillRect(10+(7*letterHolder)-1, 68, 7, 3, ST7735_WHITE);
		}
		else{
			characterIndex = network[letterHolder];
			if(button&0x4){
				if(characterIndex <= 0x20){
					characterIndex = 0x80;
				}
				characterIndex -= 1;
			}
			else{
				if(characterIndex > 0x7E){
					characterIndex = 0x1F;
				}
				characterIndex += 1;
			}
			network[letterHolder] = characterIndex;
			ST7735_DrawChar(10+(7*letterHolder), 60, network[letterHolder], ST7735_WHITE, ST7735_BLACK, 1);
		}
	}
	button = 0;
}
	
}
}
void usernameSetup(void){
	setWifiNetwork(user);

}
void wifiSetUp(void){
	while(1){
	ST7735_FillScreen(ST7735_BLACK);
	ST7735_DrawString(2, 6, "Set Wi-fi Network", ST7735_WHITE);
	ST7735_DrawString(2, 10, "Set Wi-fi Password", ST7735_WHITE);
	ST7735_FillRect(11, 68, 102, 3, ST7735_WHITE);
	uint8_t button = 0;
		while(!button){
			button = buttonStates;
			button &= 0x7;
		}
		buttonStates = 0;
		if(button&0x1){
			setWifiNetwork(&SSID[1]);
		}
		else{
			if(button&0x4){
				 ST7735_FillRect(11, 68, 102, 3, ST7735_BLACK);
				ST7735_FillRect(11, 108, 109, 3, ST7735_WHITE);
				button = 0;
				while(!button){
					button = buttonStates;
					button &= 0xB;
				}
				buttonStates = 0;
				if(button&0x1){
					setWifiNetwork(&Password[1]);
				}
				else{
					if(button&0x2){
						return;
					}
				}
			}
			else{
				return;
			}
		}
	}
}

void connect(void){
	ST7735_FillScreen(ST7735_BLACK);
	if(Connected == 0){
	ST7735_DrawString(2, 5, "Connecting To Wi-fi...", ST7735_WHITE);
	UART_OutString(SSID);
	for(int i = 0; i<1600; i++){}
	UART_OutString(Password);
	for(int i = 0; i < 16; i++){
		if(UART_InChar() == 'A'){
			i = 17;
			Connected = 1;
	}
}
	if(Connected){
		ST7735_DrawString(2, 7, "Connected", ST7735_WHITE);
	}
	else{
		ST7735_DrawString(2, 7, "Could not connect", ST7735_WHITE);
	}
}
	else{
		ST7735_DrawString(2, 7, "Connected", ST7735_WHITE);
	}
	for(int i = 0; i<4000000; i++){}
}


void hostSelection(void){
	while(1){
	ST7735_FillScreen(ST7735_BLACK);
	ST7735_DrawString(2, 5, "Are you the host?", ST7735_WHITE);
	ST7735_DrawString(9, 8, "Yes", ST7735_WHITE);
	ST7735_DrawString(9, 11, "No", ST7735_WHITE);
	uint8_t button = 0;
	if(host){
	ST7735_FillRect(54, 89, 17, 3, ST7735_WHITE);
	while(!button){
		button = buttonStates;
		button &= 0x7;
	}
	buttonStates = 0;
	if(button&0x2){
		return;
	}
	
	else{
		if(button&0x1){
			connect();
		}
		else{
		host = 0;
		}
	}
		
	}
	else{			//if not host
	ST7735_FillRect(52, 119, 15, 3, ST7735_WHITE);
			while(!button){
		button = buttonStates;
		button &= 0xB;
	}
	buttonStates = 0;
	if(button&0x2){
		return;
	}
	else{
		if(button&0x1){
			connect();
		}
		else{
		host = 1;
		}
	}
		
	}
}
	}

void Difficulty(void){
	/*
	noob is should be 3;
	undergrad should be 4;
	phd should be 7;
	*/
	int i = 0;
	difficulty = 3;
	ST7735_FillScreen(ST7735_BLACK);
	ST7735_DrawString(8, 3, "Choose Level:", ST7735_WHITE);
	ST7735_DrawString(8, 6, "NOOB", ST7735_WHITE);
	ST7735_FillRect(47, 69, 30, 3, ST7735_WHITE);
	ST7735_DrawString(6, 10, "UNDERGRAD", ST7735_WHITE);
	ST7735_DrawString(6, 14, "PHD", ST7735_WHITE);

	uint8_t button = 0;
	while(!button){
		button = buttonStates;
		button &= 0x7;
	}
	buttonStates = 0;
	if(button&0x01){}
	else{
		if(button&0x2)return;
		else{
				if(i == 2) i = 0;
				else i ++;
				if(i ==1){
					difficulty = 4;
					ST7735_FillRect(47, 69, 30, 3, ST7735_BLACK);
					ST7735_FillRect(33, 110, 57, 3, ST7735_WHITE);
					button = 0;
						while(!button){
							button = buttonStates;
							button &= 0xB;
						}
						buttonStates = 0;
						if(button&0x1){
						}
						else{
							if(button&0x2){
								return;
							}
						}
					}
			else{
				difficulty = 7;
				ST7735_FillRect(47, 110, 30, 3, ST7735_BLACK);
				ST7735_FillRect(33, 150, 57, 3, ST7735_WHITE);
				button = 0;
					while(!button){
						button = buttonStates;
						button &= 0xB;
					}
					buttonStates = 0;
					if(button&0x1){
					}
					else{
						if(button&0x2){
							return;
						}
					}
				}
			
		}
	}
	
	
}
void settings(void){
	int i = 0;
	while(1){
		ST7735_FillScreen(ST7735_BLACK);
		ST7735_DrawString(8, 6, "Host?", ST7735_WHITE);
		ST7735_FillRect(47, 69, 30, 3, ST7735_WHITE);
		ST7735_DrawString(6, 10, "Wi-Fi Setup", ST7735_WHITE);
		ST7735_DrawString(6, 14, "Difficulty", ST7735_WHITE);

		uint8_t button = 0;
		while(!button){
			button = buttonStates;
			button &= 0x7;
		}
		buttonStates = 0;
		if(button&0x1){
			if(i == 0){
				hostSelection();
			}
		}
		else{
			if(button&0x2){
				return;
			}
			else{
				if(i == 2) i = 0;
				else i ++;
				if(i ==1){
					ST7735_FillRect(47, 69, 30, 3, ST7735_BLACK);
					ST7735_FillRect(33, 110, 57, 3, ST7735_WHITE);
					button = 0;
						while(!button){
							button = buttonStates;
							button &= 0xB;
						}
						buttonStates = 0;
						if(button&0x1){
						wifiSetUp();
						}
						else{
							if(button&0x2){
								return;
							}
						}
					}
			else{
				ST7735_FillRect(47, 110, 30, 3, ST7735_BLACK);
				ST7735_FillRect(33, 150, 57, 3, ST7735_WHITE);
				button = 0;
					while(!button){
						button = buttonStates;
						button &= 0xB;
					}
					buttonStates = 0;
					if(button&0x1){
						Difficulty();
					}
					else{
						if(button&0x2){
							return;
						}
					}
				}
			}
		}
	}
}
void startGame1(void){
	uint8_t button =0;
	game_ready = 0;
	p1 = 0;
	game_check = 1;
	game_init();
	while(!game_ready){
		update_Screen();
		game_ready = buttonStates;
	}
	game_ready = 0;
	buttonStates = 0;

	while(game_check){
		while(!refresh){}
		refresh = 0;
		playgame1();

	}
	ST7735_FillScreen(ST7735_BLACK);
	editScore1();
	ST7735_DrawString(1, 4, "HAHA YOU LOST!", ST7735_WHITE);
	ST7735_DrawString(1, 6, "Better luck ", ST7735_WHITE);
	ST7735_DrawString(1,7, "next time!", ST7735_WHITE);
	ST7735_DrawString(1, 13, user, ST7735_WHITE);
	ST7735_DrawString(1, 15, score1, ST7735_WHITE);
	

	
	while(!game_ready){
		game_ready = buttonStates;
	}
	game_ready = 0;
	buttonStates = 0;
	ST7735_FillScreen(ST7735_BLACK);
	ST7735_DrawString(2, 8, "Press any button ", ST7735_WHITE);
	ST7735_DrawString(2, 9, "to go to menu", ST7735_WHITE);
	while(!button){
		button = buttonStates;
	}
	buttonStates = 0;
	return;
}

void startGame(void){
	uint8_t button =0;
	game_ready = 0;
	p1 = 0;
	p2 = 0;
	while(p1 <10 || p2<10){
		game_init();
		game_check = 1;
		buttonStates = 0;
		//wait for button press
		if(host){
		while(!game_ready){
			update_Screen();
			game_ready = buttonStates;
		}
		UART_OutChar('B');
		game_ready = 0;
		buttonStates = 0;
	}
		else{
			while(!game_ready){
				determineField();
			}
			game_ready = 0;
		}
		//wait for timer
		while(game_check){
			while(!refresh){determineField();}
			refresh = 0;
			playgame();
			determineField();

		}
		
		ST7735_FillScreen(ST7735_BLACK);
		editScore();
		ST7735_DrawString(6, 8, score, ST7735_WHITE);
		
		//wait for button press
		buttonStates = 0;
		if(host){
		while(!game_ready){
			game_ready = buttonStates;
		}
		UART_OutChar('B');
	}
		else{
			while(!game_ready){
				determineField();
			}
		}
		game_ready = 0;
		buttonStates = 0;
		ST7735_FillScreen(ST7735_BLACK);
	}
	if(p1>p2){
	ST7735_DrawString(3, 8, winner1, ST7735_WHITE);
	}
	else{
		ST7735_DrawString(3, 8, winner2, ST7735_WHITE);
	}
	ST7735_DrawString(2, 16, "Press any button to go to menu", ST7735_WHITE);
	while(!button){
		button = buttonStates;
	}
	buttonStates = 0;
	return;
}
void mainMenu(void){
	while(1){
	uint8_t button = 0;
	ST7735_FillScreen(ST7735_BLACK);
	ST7735_DrawBitmap(18, 47, Ponglogobmp,84, 34);

	ST7735_DrawString(6, 8, "Start Game", ST7735_WHITE);
	ST7735_FillRect(35, 90, 60, 3, ST7735_WHITE);
	ST7735_DrawString(6, 12, "Settings", ST7735_WHITE);
	while(!button){
		button = buttonStates;
		button &=0x5;
	}
	buttonStates = 0;					//Makes it look like no buttons are pressed on the global
	if(button&0x1){
		startGame();						//Starts the game
	}
	else{
		ST7735_FillRect(35, 90, 60, 3, ST7735_BLACK);
		ST7735_FillRect(35, 130, 50, 3, ST7735_WHITE);
		button = 0;
		while(!button){
			button = buttonStates;
			button &= 0x9;
		}
		buttonStates = 0;
		if(button&0x1){					//if left button is pressed then go to the settings menu, but if up button was pressed go back to game start
			settings();
		}	
	}
	
}
}


int main(void){
	host = 1;
    PLL_Init(Bus80MHz);                  // set system clock to 80 MHz
    ST7735_InitR(INITR_REDTAB);
		Timer2Init();
		UART_Init();
	//	for(int i =0; i <4; i++){
	//		UART_OutString("A");
	//	}
	//	UART_InString(empty, 3);
	//	ST7735_DrawString(2, 10, empty, ST7735_WHITE);

//		while(1);
		buttonInit();
    ADC0_InitSWTriggerSeq3_Ch9();
		EnableInterrupts();
		player1.now =	ConvertADC(ADC0_InSeq3());//update player1 position
		srand(player1.now);
		//startGame();
		
		mainMenu();
}
/*

    ADCVal = ADC0_InSeq3();
    ConvertADC(ADCVal);//converts ADC to a value between 0-15 (the x position of the screen)
    char* stringADC = adcToString();//returns a String to print out the length statement.
    ST7735_OutString(stringADC);
*/
